## boards/shields/extrawide/Kconfig.defconfig
```kconfig
config BUILD_OUTPUT_UF2
    default y

config ZMK_BATTERY_REPORTING
    default y

if SHIELD_EXTRAWIDE_LEFT

config ZMK_KEYBOARD_NAME
    default "extrawide"

config ZMK_SPLIT_ROLE_CENTRAL
    default y

endif # SHIELD_EXTRAWIDE_LEFT

if SHIELD_EXTRAWIDE_LEFT || SHIELD_EXTRAWIDE_RIGHT

config ZMK_SPLIT
    default y

endif # SHIELD_EXTRAWIDE_LEFT || SHIELD_EXTRAWIDE_RIGHT
```

## boards/shields/extrawide/Kconfig.shield
```kconfig
config SHIELD_EXTRAWIDE_LEFT
    def_bool $(shields_list_contains,extrawide_left)

config SHIELD_EXTRAWIDE_RIGHT
    def_bool $(shields_list_contains,extrawide_right)
```
